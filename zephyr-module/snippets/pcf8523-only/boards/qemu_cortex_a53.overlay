/*
 * Copyright (c) 2026
 * SPDX-License-Identifier: Apache-2.0
 *
 * samples/drivers/rtc: the PCF8523 alone. Stock sample binds DT_ALIAS(rtc),
 * so the alias travels with the part. Requires -S virtio-i2c.
 */

&pcf8523_0 {
	status = "okay";
};

/ {
	aliases {
		rtc = &pcf8523_0;
	};
};
