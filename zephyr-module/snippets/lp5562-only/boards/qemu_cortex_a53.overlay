/*
 * Copyright (c) 2026
 * SPDX-License-Identifier: Apache-2.0
 *
 * samples/drivers/led/lp5562: the LP5562 alone. Stock sample binds
 * DEVICE_DT_GET_ANY(ti_lp5562). Requires -S virtio-i2c.
 */

&lp5562_0 {
	status = "okay";
};
