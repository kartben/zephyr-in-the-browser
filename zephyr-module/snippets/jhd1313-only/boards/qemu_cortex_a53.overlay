/*
 * Copyright (c) 2026
 * SPDX-License-Identifier: Apache-2.0
 *
 * samples/drivers/auxdisplay: the JHD1313 alone. Stock sample binds
 * DT_NODELABEL(auxdisplay_0). Requires -S virtio-i2c.
 */

&auxdisplay_0 {
	status = "okay";
};
