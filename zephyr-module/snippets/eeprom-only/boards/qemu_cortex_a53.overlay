/*
 * Copyright (c) 2026
 * SPDX-License-Identifier: Apache-2.0
 *
 * samples/drivers/eeprom: the AT24 alone. The stock sample binds
 * DT_ALIAS(eeprom_0), so the alias travels with the part.
 *
 * Requires -S virtio-i2c, which declares eeprom0 disabled and turns the bus on.
 */

&eeprom0 {
	status = "okay";
};

/ {
	aliases {
		eeprom-0 = &eeprom0;
	};
};
