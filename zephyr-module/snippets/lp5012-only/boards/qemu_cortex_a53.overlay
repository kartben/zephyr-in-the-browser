/*
 * Copyright (c) 2026
 * SPDX-License-Identifier: Apache-2.0
 *
 * samples/drivers/led/lp50xx: the LP5012 alone. Stock sample binds
 * DEVICE_DT_GET_ANY(ti_lp5012). Requires -S virtio-i2c.
 */

&lp5012_0 {
	status = "okay";
};
