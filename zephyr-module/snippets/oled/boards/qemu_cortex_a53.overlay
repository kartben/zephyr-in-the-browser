/*
 * Copyright (c) 2026
 * SPDX-License-Identifier: Apache-2.0
 *
 * Solder the browser's SSD1306 onto the bus and make it the guest's display.
 *
 * Requires the virtio-i2c snippet, which is what declares ssd1306_0 and turns
 * the bus on. Use them together:
 *
 *   west build -b qemu_cortex_a53 -S virtio-i2c -S oled samples/drivers/display
 *
 * Note there is no `-S ramfb` in that line, and that is the whole point: the
 * two displays are alternatives, so a build that draws on the OLED never
 * declares the framebuffer. (`&ramfb0 { status = "disabled" }` is still here
 * for a build that asked for both — last overlay wins, and this one is meant to.)
 *
 * Unlike ramfb and virtio-gpu, there is no framebuffer anywhere in this path.
 * The driver pushes pixels over I2C into GDDRAM that lives in page JavaScript
 * (src/virtio/devices/chips/ssd1306.ts), and the OLED panel paints that.
 */

&ssd1306_0 {
	status = "okay";
};

/ {
	chosen {
		zephyr,display = &ssd1306_0;
	};
};

&ramfb0 {
	status = "disabled";
};
