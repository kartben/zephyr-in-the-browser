/*
 * Copyright (c) 2026
 * SPDX-License-Identifier: Apache-2.0
 *
 * samples/drivers/ht16k33: the HT16K33 alone. Stock sample binds
 * DT_COMPAT_GET_ANY_STATUS_OKAY(holtek_ht16k33). Requires -S virtio-i2c.
 */

&ht16k33_0 {
	status = "okay";
};
