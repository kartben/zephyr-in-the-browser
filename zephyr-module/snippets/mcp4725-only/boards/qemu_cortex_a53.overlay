/*
 * Copyright (c) 2026
 * SPDX-License-Identifier: Apache-2.0
 *
 * samples/drivers/dac: the MCP4725 alone, plus the /zephyr,user channel props
 * the stock sample binds — DT_PROP(DT_PATH(zephyr_user), dac) and
 * dac-channel-id / dac-resolution. Requires -S virtio-i2c.
 */

&mcp4725_0 {
	status = "okay";
};

/ {
	zephyr,user {
		dac = <&mcp4725_0>;
		dac-channel-id = <0>;
		dac-resolution = <12>;
	};
};
