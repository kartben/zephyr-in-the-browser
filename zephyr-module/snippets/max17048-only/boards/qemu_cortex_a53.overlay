/*
 * Copyright (c) 2026
 * SPDX-License-Identifier: Apache-2.0
 *
 * samples/drivers/fuel_gauge: the MAX17048 alone, aliased fuel-gauge0 because
 * the stock sample binds DEVICE_DT_GET(DT_ALIAS(fuel_gauge0)).
 * Requires -S virtio-i2c.
 */

&max17048_0 {
	status = "okay";
};

/ {
	aliases {
		fuel-gauge0 = &max17048_0;
	};
};
