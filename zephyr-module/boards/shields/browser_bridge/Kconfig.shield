## zephyr-module/boards/shields/browser_bridge/Kconfig.shield
```kconfig
# Copyright (c) 2026
# SPDX-License-Identifier: Apache-2.0

config SHIELD_BROWSER_BRIDGE
	def_bool $(shields_list_contains,browser_bridge)
```

## zephyr-module/dts/bindings/audio/qemu,host-audio.yaml
```yaml
# Copyright (c) 2026
# SPDX-License-Identifier: Apache-2.0

description: |
  Host-drained audio output exposed by QEMU over MMIO.

  The guest pushes 16-bit mono PCM samples through a data register into a ring
  the QEMU host consumes, rather than into emulated audio hardware. Under
  qemu-wasm that host is a browser, so the samples end up in the Web Audio API.
  The sample rate and ring capacity are fixed by the device and read back from
  its registers.

compatible: "qemu,host-audio"

include: base.yaml

properties:
  reg:
    required: true
```

## zephyr-module/dts/bindings/audio/qemu,host-mic.yaml
```yaml
# Copyright (c) 2026
# SPDX-License-Identifier: Apache-2.0

description: |
  Host-filled microphone exposed by QEMU over MMIO.

  The QEMU host pushes 16-bit mono PCM samples into a ring the guest pops
  through a data register, rather than the guest sampling emulated PDM
  hardware. Under qemu-wasm that host is a browser capturing getUserMedia
  audio, so a Zephyr DMIC driver on this node records from the user's real
  microphone. The sample rate and ring capacity are fixed by the device and
  read back from its registers.

compatible: "qemu,host-mic"

include: base.yaml

properties:
  reg:
    required: true
```

## zephyr-module/dts/bindings/display/virtio,gpu.yaml
```yaml
# Copyright (c) 2026 The Zephyr Project Contributors
# SPDX-License-Identifier: Apache-2.0

description: VIRTIO GPU display device

compatible: "virtio,gpu"

include: display-controller.yaml

properties:
  memory-region:
    type: phandle
    required: true
    description: |
      Reserved, physically contiguous memory used as the framebuffer backing
      store.

  scanout:
    type: int
    default: 0
    description: VIRTIO GPU scanout index to use.
```

## zephyr-module/dts/bindings/gpio/qemu,host-gpio.yaml
```yaml
# Copyright (c) 2026
# SPDX-License-Identifier: Apache-2.0

description: |
  Host-backed GPIO exposed by QEMU over MMIO.

  Input pins are driven by the QEMU host and output pins are observed by it,
  rather than being wired to emulated hardware. Under qemu-wasm that host is a
  browser, so a page can raise buttons on the inputs and light indicators from
  the outputs the guest drives.

compatible: "qemu,host-gpio"

include: [gpio-controller.yaml, base.yaml]

properties:
  reg:
    required: true

  # ngpios is inherited from gpio-controller.yaml (default 32); the device
  # overlay sets it to the real pin count. Not re-declared here because marking
  # an inherited-with-default property "required" is a binding warning.

gpio-cells:
  - pin
  - flags
```

## zephyr-module/dts/bindings/sensor/qemu,host-sensor.yaml
```yaml
# Copyright (c) 2026
# SPDX-License-Identifier: Apache-2.0

description: |
  Host-backed sensor exposed by QEMU over MMIO.

  Sample values are written by the QEMU host rather than produced by emulated
  hardware, which lets a browser feed real or simulated readings to the guest
  when running under qemu-wasm.

compatible: "qemu,host-sensor"

include: [sensor-device.yaml, base.yaml]

properties:
  reg:
    required: true
```
