## CMakeLists.txt
```
# SPDX-FileCopyrightText: Copyright The Zephyr Project Contributors
# SPDX-License-Identifier: Apache-2.0

cmake_minimum_required(VERSION 3.28.0)

find_package(Zephyr REQUIRED HINTS $ENV{ZEPHYR_BASE})
project(kite_rush)

target_sources(app PRIVATE
  src/controls.c
  src/font.c
  src/game.c
  src/gfx.c
  src/kite.c
  src/main.c
  src/render.c
  src/storage.c
  src/telemetry.c
)
```

## Kconfig
```
# SPDX-FileCopyrightText: Copyright The Zephyr Project Contributors
# SPDX-License-Identifier: Apache-2.0

mainmenu "Kite Rush"

configdefault FPU
	default y if CPU_HAS_FPU

# Keep the high scores on the storage partition, when the board has one
DT_STORAGE_PARTITION_OKAY := $(dt_nodelabel_enabled,storage_partition)

configdefault FLASH
	default y if $(DT_STORAGE_PARTITION_OKAY)

configdefault FLASH_MAP
	default y if $(DT_STORAGE_PARTITION_OKAY)

configdefault ZMS
	default y if $(DT_STORAGE_PARTITION_OKAY)

configdefault SETTINGS
	default y if $(DT_STORAGE_PARTITION_OKAY)

config KITE_RUSH_STRIP_BUFFER_SIZE
	int "Display strip buffer size in bytes"
	default 16384
	help
	  The game is drawn one row at a time and sent to the display in strips.
	  The buffer must hold at least one scaled row of the display. Bigger
	  buffers mean fewer, larger display writes.

config KITE_RUSH_DISPLAY_THREAD
	bool "Draw the next strip while the previous one is sent"
	default y
	help
	  Hand the strips to a display thread through two buffers, so that the
	  game draws the next strip while the previous one is transferred. This
	  pays off with display drivers that sleep during DMA transfers, and
	  doubles the strip buffer memory.

config KITE_RUSH_SKIP_UNCHANGED_ROWS
	bool "Only send the rows that changed"
	default y
	help
	  Keep a hash of each row and skip the rows that did not change since
	  the previous frame. Only applies to displays that keep their own
	  memory, not to frame buffer displays.

config KITE_RUSH_INTERLACE
	bool "Interlaced display updates"
	help
	  Draw and send the even rows on one frame and the odd rows on the next.
	  This halves the work per frame on slow display links, at the cost of
	  combing on fast motion.

config KITE_RUSH_ROTATE_180
	bool "Turn the picture upside down"
	help
	  Draw the game rotated by 180 degrees, and turn the touchscreen
	  coordinates to match, for a display mounted the other way round.

config KITE_RUSH_MAX_PRIMS
	int "Maximum number of drawing primitives per frame"
	default 384

config KITE_RUSH_TARGET_FPS
	int "Frame rate cap"
	default 60
	range 10 60

config KITE_RUSH_INVERT_PITCH
	bool "Pull the stick back to climb"
	help
	  Use the aircraft convention for the pitch stick instead of pushing the
	  stick up to climb.

config KITE_RUSH_PROFILE
	bool "Log where the frame time goes"
	help
	  Log, along with the frame rate, the average time per frame spent in
	  the game logic, building the scene, drawing the rows, converting them
	  for the display and waiting for the display.

config KITE_RUSH_AUTOPLAY
	bool "Autopilot plays complete games"
	help
	  Let the autopilot play full games in a loop, without a pilot. Useful
	  to check the game on a board without an RC link. Its scores enter the
	  high score table as BOT.

config KITE_RUSH_RESET_CODE
	string "Code that clears the high scores"
	default "ZAP"
	help
	  Three letters or digits to enter on the reset screen to clear the
	  high score table. The reset screen opens from the title screen when
	  the throttle is at mid-stick, with full left rudder and full up pitch,
	  for two seconds.

source "Kconfig.zephyr"
```

## prj.conf
```kconfig
CONFIG_INPUT=y
# Stick values are stored by the callback right away, no input thread needed
CONFIG_INPUT_MODE_SYNCHRONOUS=y
CONFIG_DISPLAY=y
CONFIG_SERIAL=y
CONFIG_UART_INTERRUPT_DRIVEN=y

# The renderer's per-pixel loops are worth optimizing for speed
CONFIG_SPEED_OPTIMIZATIONS=y

CONFIG_LOG=y
CONFIG_MAIN_STACK_SIZE=4096
```

## src/main.c
```c
/*
 * SPDX-FileCopyrightText: Copyright The Zephyr Project Contributors
 * SPDX-License-Identifier: Apache-2.0
 */

#include <zephyr/device.h>
#include <zephyr/devicetree.h>
#include <zephyr/drivers/display.h>
#include <zephyr/kernel.h>
#include <zephyr/logging/log.h>
#include <zephyr/sys/util.h>

#include "controls.h"
#include "game.h"
#include "render.h"
#include "storage.h"
#include "telemetry.h"

LOG_MODULE_REGISTER(kite_rush, LOG_LEVEL_INF);

#define FRAME_MS (1000 / CONFIG_KITE_RUSH_TARGET_FPS)

static struct game game;

int main(void)
{
	const struct device *display = DEVICE_DT_GET(DT_CHOSEN(zephyr_display));
	const struct device *receiver = controls_receiver();
	struct high_score scores[GAME_HIGH_SCORES];
	struct controls ctl;
	int64_t last, fps_start, deadline;
	uint32_t frames = 0;
	uint32_t logic = 0;
	int ret;

	if (!device_is_ready(display)) {
		LOG_ERR("Display %s not ready", display->name);
		return 0;
	}

	ret = render_init(display);
	if (ret < 0) {
		return 0;
	}

	if (receiver != NULL && !device_is_ready(receiver)) {
		LOG_WRN("CRSF receiver not ready, telemetry disabled");
		telemetry_init(NULL);
	} else {
		telemetry_init(receiver);
	}

	game_init(&game, k_cycle_get_32());
	if (storage_load_scores(scores, ARRAY_SIZE(scores)) == 0) {
		game_set_scores(&game, scores, ARRAY_SIZE(scores));
	}
	controls_init(&game, display);
	LOG_INF("Kite Rush ready, push the throttle up to fly");

	last = k_uptime_get();
	fps_start = last;
	deadline = last;

	while (true) {
		int64_t now = k_uptime_get();
		uint32_t t0;
		float dt = CLAMP((float)(now - last) / 1000.0f, 0.001f, 0.05f);

		last = now;
		controls_read(&ctl);
		t0 = k_cycle_get_32();
		game_update(&game, &ctl, dt);
		logic += k_cycle_get_32() - t0;
		render_frame(&game, &ctl);
		telemetry_update(&game, now);

		frames++;
		if (now - fps_start >= 10000) {
			uint32_t fps = frames * 1000U / (uint32_t)(now - fps_start);

			LOG_INF("%u fps, phase %d, score %u", fps, game.phase, game.score);
			if (IS_ENABLED(CONFIG_KITE_RUSH_PROFILE)) {
				struct render_stats rs;

				render_take_stats(&rs);
				LOG_INF("us per frame: logic %u scene %u background %u shapes %u "
					"output %u wait %u, rows sent %u",
					k_cyc_to_us_floor32(logic / frames),
					k_cyc_to_us_floor32(rs.scene / frames),
					k_cyc_to_us_floor32(rs.background / frames),
					k_cyc_to_us_floor32(rs.shapes / frames),
					k_cyc_to_us_floor32(rs.output / frames),
					k_cyc_to_us_floor32(rs.wait / frames),
					rs.rows_sent / frames);
			}
			logic = 0;
			frames = 0;
			fps_start = now;
		}

		/*
		 * Absolute deadlines keep the pace exact. A late frame resyncs and
		 * still sleeps, so lower priority threads are never starved.
		 */
		deadline += FRAME_MS;
		if (deadline <= k_uptime_get()) {
			deadline = k_uptime_get() + 1;
		}
		k_sleep(K_TIMEOUT_ABS_MS(deadline));
	}

	return 0;
}
```

## src/controls.c
```c
/*
 * SPDX-FileCopyrightText: Copyright The Zephyr Project Contributors
 * SPDX-License-Identifier: Apache-2.0
 */

#include <stdlib.h>

#include <zephyr/device.h>
#include <zephyr/devicetree.h>
#include <zephyr/drivers/display.h>
#include <zephyr/input/input.h>
#include <zephyr/kernel.h>
#include <zephyr/spinlock.h>
#include <zephyr/sys/atomic.h>
#include <zephyr/sys/util.h>

#include "controls.h"

#if DT_HAS_COMPAT_STATUS_OKAY(tbs_crsf)
static const struct device *const crsf_dev =
	DEVICE_DT_GET(DT_COMPAT_GET_ANY_STATUS_OKAY(tbs_crsf));
#else
static const struct device *const crsf_dev;
#endif

#if DT_HAS_CHOSEN(zephyr_touch)
static const struct device *const touch_dev = DEVICE_DT_GET(DT_CHOSEN(zephyr_touch));
#else
static const struct device *const touch_dev;
#endif

/*
 * Without a radio, the keys or the touchscreen of the board fly the kite: the
 * arrow keys (joystick, trackball) or a drag on the touchscreen move the right
 * stick, B and A move the rudder, and a press of the action key or a tap
 * starts a game, or does a barrel roll in flight.
 */
#define HAS_TOUCH       DT_HAS_CHOSEN(zephyr_touch)
#define HAS_KEYS        DT_HAS_COMPAT_STATUS_OKAY(gpio_keys)
#define DEFAULT_SOURCE  (HAS_TOUCH ? CONTROL_TOUCH : CONTROL_KEYS)
#define CRUISE_THROTTLE 0.6f

/* Without a sync for that long, the radio is considered gone */
#define LINK_TIMEOUT_MS 500
/* A trackball step steers that long, so steps run into each other */
#define KEY_HOLD_MS     120
/* Taps and action presses act for that long */
#define PULSE_MS        150
#define TAP_MS          300

enum key {
	KEY_UP,
	KEY_DOWN,
	KEY_LEFT,
	KEY_RIGHT,
	KEY_ACTION,
	KEY_B,
	KEY_A,
	KEY_COUNT,
};

/* Stick values in microseconds, as reported by RC input drivers */
static atomic_t axis_roll = ATOMIC_INIT(1500);
static atomic_t axis_pitch = ATOMIC_INIT(1500);
static atomic_t axis_throttle = ATOMIC_INIT(1000);
static atomic_t axis_yaw = ATOMIC_INIT(1500);
static atomic_t last_sync_ms;
static atomic_t link_seen;
static bool rc_pending;

static const struct game *game;
static int32_t disp_w, disp_h;
static int32_t touch_radius; /* drag for a full stick deflection, in pixels */

static struct k_spinlock lock;
static struct {
	int64_t held_until[KEY_COUNT]; /* INT64_MAX while pressed */
	int32_t x, y;                  /* last touch position */
	int32_t x0, y0;                /* where the finger came down */
	int64_t down_ms;
	bool down;                     /* in the report being received */
	bool pressed;                  /* as of the last complete report */
	bool touching;                 /* finger down on the screen */
	bool moved;
	int8_t strip_key;              /* key held below the screen, -1 if none */
	int64_t launch_until;
	int64_t yaw_until;
	float yaw_dir;
	uint32_t last_ms;              /* last local input */
	uint8_t source;
} local = {
	.strip_key = -1,
	.source = DEFAULT_SOURCE,
};

static uint8_t last_source = DEFAULT_SOURCE;

static bool held(enum key k, int64_t now)
{
	return now < local.held_until[k];
}

/* Starts a game from the title or game over screens, else a barrel roll (A or B in menus) */
static void action(int64_t now, float dir)
{
	if (game->phase == PHASE_ATTRACT || game->phase == PHASE_GAME_OVER) {
		local.launch_until = now + PULSE_MS;
	} else {
		local.yaw_until = now + PULSE_MS;
		local.yaw_dir = dir;
	}
}

static void press(enum key k, bool down, int64_t now)
{
	if (!down) {
		local.held_until[k] = now + KEY_HOLD_MS;
		return;
	}

	local.held_until[k] = INT64_MAX;
	if (k == KEY_ACTION) {
		action(now, held(KEY_LEFT, now) ? -1.0f : 1.0f);
	}
}

static int key_of(uint16_t code)
{
	switch (code) {
	case INPUT_KEY_UP:
		return KEY_UP;
	case INPUT_KEY_DOWN:
		return KEY_DOWN;
	case INPUT_KEY_LEFT:
		return KEY_LEFT;
	case INPUT_KEY_RIGHT:
		return KEY_RIGHT;
	case INPUT_KEY_ENTER:
	case INPUT_BTN_START:
		return KEY_ACTION;
	case INPUT_BTN_B:
		return KEY_B;
	case INPUT_BTN_A:
		return KEY_A;
	default:
		return -1;
	}
}

/* Some panels go past the bottom of the display, as buttons: B, action and A */
static void touch_down(int64_t now)
{
	if (local.y >= disp_h) {
		local.strip_key = local.x < disp_w / 3 ? KEY_B
				  : (local.x < 2 * disp_w / 3 ? KEY_ACTION : KEY_A);
		press((enum key)local.strip_key, true, now);
		return;
	}

	local.touching = true;
	local.moved = false;
	local.x0 = local.x;
	local.y0 = local.y;
	local.down_ms = now;
}

static void touch_up(int64_t now)
{
	if (local.strip_key >= 0) {
		press((enum key)local.strip_key, false, now);
		local.strip_key = -1;
	}

	if (local.touching && !local.moved && now - local.down_ms < TAP_MS) {
		action(now, local.x0 < disp_w / 2 ? -1.0f : 1.0f);
	}
	local.touching = false;
}

static void touch_event(struct input_event *evt, int64_t now)
{
	switch (evt->code) {
	case INPUT_ABS_X:
		local.x = IS_ENABLED(CONFIG_KITE_RUSH_ROTATE_180) ? disp_w - 1 - evt->value
								 : evt->value;
		break;
	case INPUT_ABS_Y:
		/* Touches below the picture stay there, as buttons */
		local.y = IS_ENABLED(CONFIG_KITE_RUSH_ROTATE_180) && evt->value < disp_h
				  ? disp_h - 1 - evt->value
				  : evt->value;
		break;
	case INPUT_BTN_TOUCH:
	case INPUT_BTN_LEFT:
		local.down = evt->value != 0;
		break;
	default:
		break;
	}

	/* Act on complete reports. Hovering, as a mouse does in QEMU, is not input */
	if (evt->sync == 0U || disp_w == 0 || (!local.down && !local.pressed)) {
		return;
	}

	if (!local.pressed) {
		touch_down(now);
	} else if (!local.down) {
		touch_up(now);
	} else if (abs(local.x - local.x0) > touch_radius / 4 ||
		   abs(local.y - local.y0) > touch_radius / 4) {
		local.moved = true;
	}

	local.pressed = local.down;
	local.last_ms = (uint32_t)now;
	local.source = CONTROL_TOUCH;
}

static void rc_event(struct input_event *evt)
{
	switch (evt->code) {
	case INPUT_ABS_RX:
		atomic_set(&axis_roll, evt->value);
		break;
	case INPUT_ABS_RY:
		atomic_set(&axis_pitch, evt->value);
		break;
	case INPUT_ABS_THROTTLE:
		atomic_set(&axis_throttle, evt->value);
		break;
	case INPUT_ABS_RUDDER:
		atomic_set(&axis_yaw, evt->value);
		break;
	default:
		return;
	}

	rc_pending = true;
}

static void input_cb(struct input_event *evt, void *user_data)
{
	int64_t now = k_uptime_get();
	k_spinlock_key_t key;
	int k;

	ARG_UNUSED(user_data);

	if (evt->dev != NULL && evt->dev == touch_dev) {
		key = k_spin_lock(&lock);
		touch_event(evt, now);
		k_spin_unlock(&lock, key);
		return;
	}

	if (evt->type == INPUT_EV_KEY && game != NULL) {
		k = key_of(evt->code);
		if (k >= 0) {
			key = k_spin_lock(&lock);
			press((enum key)k, evt->value != 0, now);
			local.last_ms = (uint32_t)now;
			local.source = CONTROL_KEYS;
			k_spin_unlock(&lock, key);
		}
	}

	if (evt->type == INPUT_EV_ABS) {
		rc_event(evt);
	}

	/* Without a receiver node, any device reporting the stick axes is the radio */
	if (evt->sync != 0U &&
	    (crsf_dev != NULL ? evt->dev == crsf_dev : rc_pending)) {
		atomic_set(&last_sync_ms, (atomic_val_t)(uint32_t)now);
		atomic_set(&link_seen, 1);
		rc_pending = false;
	}
}
INPUT_CALLBACK_DEFINE(NULL, input_cb, NULL);

static float stick(atomic_t *axis)
{
	float v = ((float)atomic_get(axis) - 1500.0f) / 500.0f;

	if (v > -0.04f && v < 0.04f) {
		return 0.0f;
	}

	return CLAMP(v, -1.0f, 1.0f);
}

static void read_radio(struct controls *ctl, bool alive)
{
	ctl->roll = stick(&axis_roll);
	ctl->pitch = stick(&axis_pitch);
	ctl->yaw = stick(&axis_yaw);
	ctl->throttle = CLAMP(((float)atomic_get(&axis_throttle) - 1000.0f) / 1000.0f, 0.0f, 1.0f);
	ctl->valid = alive;
	ctl->source = CONTROL_RC;
}

static void read_local(struct controls *ctl, int64_t now)
{
	bool flying = game->phase == PHASE_COUNTDOWN || game->phase == PHASE_FLYING ||
		      game->phase == PHASE_SIGNAL_LOST;
	k_spinlock_key_t key = k_spin_lock(&lock);
	float roll = 0.0f;
	float pitch = 0.0f;
	float yaw = 0.0f;

	roll += held(KEY_RIGHT, now) ? 1.0f : 0.0f;
	roll -= held(KEY_LEFT, now) ? 1.0f : 0.0f;
	pitch += held(KEY_UP, now) ? 1.0f : 0.0f;
	pitch -= held(KEY_DOWN, now) ? 1.0f : 0.0f;
	yaw += held(KEY_A, now) ? 1.0f : 0.0f;
	yaw -= held(KEY_B, now) ? 1.0f : 0.0f;

	/* The finger is a stick centered where it came down, taps do not steer */
	if (local.touching && local.moved) {
		roll += (float)(local.x - local.x0) / (float)touch_radius;
		pitch += (float)(local.y0 - local.y) / (float)touch_radius;
	}

	if (now < local.yaw_until) {
		yaw = local.yaw_dir;
	}

	if (flying) {
		ctl->throttle = CRUISE_THROTTLE;
	} else if (held(KEY_B, now) && held(KEY_UP, now)) {
		/* With B and up held, the stick command that opens the reset screen */
		ctl->throttle = 0.5f;
	} else {
		ctl->throttle = now < local.launch_until ? 1.0f : 0.0f;
	}

	ctl->roll = CLAMP(roll, -1.0f, 1.0f);
	ctl->pitch = CLAMP(pitch, -1.0f, 1.0f);
	ctl->yaw = CLAMP(yaw, -1.0f, 1.0f);
	ctl->valid = true;
	ctl->source = local.source;
	k_spin_unlock(&lock, key);
}

void controls_read(struct controls *ctl)
{
	int64_t now = k_uptime_get();
	uint32_t last_sync = (uint32_t)atomic_get(&last_sync_ms);
	bool alive = atomic_get(&link_seen) != 0 && (uint32_t)now - last_sync < LINK_TIMEOUT_MS;
	bool in_run = game->phase == PHASE_COUNTDOWN || game->phase == PHASE_FLYING ||
		      game->phase == PHASE_SIGNAL_LOST;

	/* A radio pilot who loses the link mid-run is waited for, unless someone takes over */
	if (alive || !(HAS_TOUCH || HAS_KEYS) ||
	    (in_run && last_source == CONTROL_RC && (int32_t)(local.last_ms - last_sync) < 0)) {
		read_radio(ctl, alive);
	} else {
		read_local(ctl, now);
	}

	if (IS_ENABLED(CONFIG_KITE_RUSH_INVERT_PITCH)) {
		ctl->pitch = -ctl->pitch;
	}

	last_source = ctl->source;
}

void controls_init(const struct game *g, const struct device *display)
{
	struct display_capabilities caps;

	game = g;
	display_get_capabilities(display, &caps);
	touch_radius = MIN(caps.x_resolution, caps.y_resolution) / 6;
	disp_h = caps.y_resolution;
	disp_w = caps.x_resolution;
}

const struct device *controls_receiver(void)
{
	return crsf_dev;
}
```

## src/controls.h
```c
/*
 * SPDX-FileCopyrightText: Copyright The Zephyr Project Contributors
 * SPDX-License-Identifier: Apache-2.0
 */

#ifndef KITE_RUSH_CONTROLS_H_
#define KITE_RUSH_CONTROLS_H_

#include <zephyr/device.h>

#include "game.h"

/* The game decides what a press or a tap does, the display scales the touchscreen */
void controls_init(const struct game *g, const struct device *display);
void controls_read(struct controls *ctl);

/* CRSF receiver the radio sticks come from, NULL if none */
const struct device *controls_receiver(void);

#endif /* KITE_RUSH_CONTROLS_H_ */
```

## src/font.c
```c
/*
 * SPDX-FileCopyrightText: Copyright The Zephyr Project Contributors
 * SPDX-License-Identifier: Apache-2.0
 */

#include <stddef.h>

#include "font.h"

static const char glyph_chars[] = "0123456789ABCDEFGHIJKLMNOPQRSTUVWXYZ!+-.:x?',/%*>";

static const uint8_t glyphs[][FONT_HEIGHT] = {
	{0x0e, 0x11, 0x13, 0x15, 0x19, 0x11, 0x0e}, /* 0 */
	{0x04, 0x0c, 0x04, 0x04, 0x04, 0x04, 0x0e}, /* 1 */
	{0x0e, 0x11, 0x01, 0x02, 0x04, 0x08, 0x1f}, /* 2 */
	{0x1f, 0x02, 0x04, 0x02, 0x01, 0x11, 0x0e}, /* 3 */
	{0x02, 0x06, 0x0a, 0x12, 0x1f, 0x02, 0x02}, /* 4 */
	{0x1f, 0x10, 0x1e, 0x01, 0x01, 0x11, 0x0e}, /* 5 */
	{0x06, 0x08, 0x10, 0x1e, 0x11, 0x11, 0x0e}, /* 6 */
	{0x1f, 0x01, 0x02, 0x04, 0x08, 0x08, 0x08}, /* 7 */
	{0x0e, 0x11, 0x11, 0x0e, 0x11, 0x11, 0x0e}, /* 8 */
	{0x0e, 0x11, 0x11, 0x0f, 0x01, 0x02, 0x0c}, /* 9 */
	{0x0e, 0x11, 0x11, 0x1f, 0x11, 0x11, 0x11}, /* A */
	{0x1e, 0x11, 0x11, 0x1e, 0x11, 0x11, 0x1e}, /* B */
	{0x0e, 0x11, 0x10, 0x10, 0x10, 0x11, 0x0e}, /* C */
	{0x1c, 0x12, 0x11, 0x11, 0x11, 0x12, 0x1c}, /* D */
	{0x1f, 0x10, 0x10, 0x1e, 0x10, 0x10, 0x1f}, /* E */
	{0x1f, 0x10, 0x10, 0x1e, 0x10, 0x10, 0x10}, /* F */
	{0x0e, 0x11, 0x10, 0x17, 0x11, 0x11, 0x0f}, /* G */
	{0x11, 0x11, 0x11, 0x1f, 0x11, 0x11, 0x11}, /* H */
	{0x0e, 0x04, 0x04, 0x04, 0x04, 0x04, 0x0e}, /* I */
	{0x07, 0x02, 0x02, 0x02, 0x02, 0x12, 0x0c}, /* J */
	{0x11, 0x12, 0x14, 0x18, 0x14, 0x12, 0x11}, /* K */
	{0x10, 0x10, 0x10, 0x10, 0x10, 0x10, 0x1f}, /* L */
	{0x11, 0x1b, 0x15, 0x15, 0x11, 0x11, 0x11}, /* M */
	{0x11, 0x11, 0x19, 0x15, 0x13, 0x11, 0x11}, /* N */
	{0x0e, 0x11, 0x11, 0x11, 0x11, 0x11, 0x0e}, /* O */
	{0x1e, 0x11, 0x11, 0x1e, 0x10, 0x10, 0x10}, /* P */
	{0x0e, 0x11, 0x11, 0x11, 0x15, 0x12, 0x0d}, /* Q */
	{0x1e, 0x11, 0x11, 0x1e, 0x14, 0x12, 0x11}, /* R */
	{0x0f, 0x10, 0x10, 0x0e, 0x01, 0x01, 0x1e}, /* S */
	{0x1f, 0x04, 0x04, 0x04, 0x04, 0x04, 0x04}, /* T */
	{0x11, 0x11, 0x11, 0x11, 0x11, 0x11, 0x0e}, /* U */
	{0x11, 0x11, 0x11, 0x11, 0x11, 0x0a, 0x04}, /* V */
	{0x11, 0x11, 0x11, 0x15, 0x15, 0x15, 0x0a}, /* W */
	{0x11, 0x11, 0x0a, 0x04, 0x0a, 0x11, 0x11}, /* X */
	{0x11, 0x11, 0x11, 0x0a, 0x04, 0x04, 0x04}, /* Y */
	{0x1f, 0x01, 0x02, 0x04, 0x08, 0x10, 0x1f}, /* Z */
	{0x04, 0x04, 0x04, 0x04, 0x04, 0x00, 0x04}, /* ! */
	{0x00, 0x04, 0x04, 0x1f, 0x04, 0x04, 0x00}, /* + */
	{0x00, 0x00, 0x00, 0x1f, 0x00, 0x00, 0x00}, /* - */
	{0x00, 0x00, 0x00, 0x00, 0x00, 0x0c, 0x0c}, /* . */
	{0x00, 0x0c, 0x0c, 0x00, 0x0c, 0x0c, 0x00}, /* : */
	{0x00, 0x00, 0x11, 0x0a, 0x04, 0x0a, 0x11}, /* x */
	{0x0e, 0x11, 0x01, 0x02, 0x04, 0x00, 0x04}, /* ? */
	{0x04, 0x04, 0x08, 0x00, 0x00, 0x00, 0x00}, /* ' */
	{0x00, 0x00, 0x00, 0x00, 0x0c, 0x04, 0x08}, /* , */
	{0x01, 0x01, 0x02, 0x04, 0x08, 0x10, 0x10}, /* / */
	{0x18, 0x19, 0x02, 0x04, 0x08, 0x13, 0x03}, /* % */
	{0x00, 0x15, 0x0e, 0x1f, 0x0e, 0x15, 0x00}, /* * */
	{0x08, 0x04, 0x02, 0x01, 0x02, 0x04, 0x08}, /* > */
};

static const uint8_t blank[FONT_HEIGHT];

const uint8_t *font_glyph(char c)
{
	if (c >= 'a' && c <= 'z' && c != 'x') {
		c = (char)(c - 'a' + 'A');
	}

	for (size_t i = 0; i < sizeof(glyph_chars) - 1U; i++) {
		if (glyph_chars[i] == c) {
			return glyphs[i];
		}
	}

	return blank;
}
```

## src/font.h
```c
/*
 * SPDX-FileCopyrightText: Copyright The Zephyr Project Contributors
 * SPDX-License-Identifier: Apache-2.0
 */

#ifndef KITE_RUSH_FONT_H_
#define KITE_RUSH_FONT_H_

#include <stdint.h>

#define FONT_WIDTH  5
#define FONT_HEIGHT 7

/* Returns FONT_HEIGHT rows, bit 4 is the leftmost column */
const uint8_t *font_glyph(char c);

#endif /* KITE_RUSH_FONT_H_ */
```

## src/game.h
```c
/*
 * SPDX-FileCopyrightText: Copyright The Zephyr Project Contributors
 * SPDX-License-Identifier: Apache-2.0
 */

#ifndef KITE_RUSH_GAME_H_
#define KITE_RUSH_GAME_H_

#include <stdbool.h>
#include <stddef.h>
#include <stdint.h>

#define GAME_MAX_GATES     8
#define GAME_MAX_BUGS      12
#define GAME_MAX_PARTICLES 128
#define GAME_MAX_POPUPS    6

/* Seconds of daylight: the sun height is the remaining time */
#define GAME_SUN_MAX   30.0f
#define GAME_SUN_START 20.0f

/* Flight envelope in world units, y is the height above the ground */
#define GAME_Y_MIN     0.6f
#define GAME_Y_MAX     5.6f
#define GAME_SPEED_MIN 10.0f
#define GAME_SPEED_MAX 24.0f

#define GAME_ROLL_DURATION 0.55f

#define GAME_HIGH_SCORES 8
#define GAME_NAME_LEN    3

enum game_phase {
	PHASE_ATTRACT = 0,
	PHASE_COUNTDOWN = 1,
	PHASE_FLYING = 2,
	PHASE_GAME_OVER = 3,
	PHASE_SIGNAL_LOST = 4,
	PHASE_NAME_ENTRY = 5,
	PHASE_RESET_CODE = 6,
};

/* Where the pilot inputs come from, for the prompts on screen */
enum control_source {
	CONTROL_RC,    /* radio sticks */
	CONTROL_KEYS,  /* keys, joystick or trackball of the board */
	CONTROL_TOUCH, /* touchscreen of the board */
};

/* Normalized pilot inputs */
struct controls {
	float roll;     /* -1 (left) .. 1 (right) */
	float pitch;    /* -1 (down) .. 1 (up) */
	float throttle; /* 0 .. 1 */
	float yaw;      /* -1 (left) .. 1 (right) */
	bool valid;     /* a pilot is connected and the link is alive */
	uint8_t source; /* enum control_source */
};

enum gate_state {
	GATE_PENDING,
	GATE_PASSED,
	GATE_PERFECT,
	GATE_MISSED,
};

struct gate {
	float x, y, z;
	float base_x;
	float half;     /* half of the opening size */
	float move_amp; /* lateral sway amplitude, 0 for static gates */
	float move_phase;
	float flash;    /* seconds of highlight left after a pass or a miss */
	uint16_t index; /* sequence number, used for alternating colors */
	uint8_t state;
};

struct bug {
	float x, y, z;
	float base_x, base_y;
	float wobble; /* sway amplitude */
	float phase;
	float splat;  /* seconds of splat animation left, 0 if alive */
	bool active;
};

enum particle_kind {
	PARTICLE_SPARK,    /* additive square */
	PARTICLE_CONFETTI, /* tumbling triangle */
	PARTICLE_STREAK,   /* wind line along the flight direction */
};

/* Particles live in world space so the camera flies through them */
struct particle {
	float x, y, z;
	float vx, vy, vz;
	float life, max_life;
	float size; /* world units, length along z for streaks */
	uint32_t color;
	uint8_t kind;
};

/* Popups are drawn relative to the kite, offsets in logical pixels */
struct popup {
	char text[16];
	float dx, dy;
	float life;
	uint32_t color;
	uint8_t scale;
};

/* Score 0 marks an empty slot */
struct high_score {
	uint32_t score;
	char name[GAME_NAME_LEN];
	uint8_t level;
};

enum reset_result {
	RESET_NONE,
	RESET_CLEARED,
	RESET_WRONG_CODE,
};

/* Three letters picked with the right stick, for a name or the reset code */
struct letter_entry {
	char text[GAME_NAME_LEN + 1];
	uint8_t pos;     /* letter being edited */
	float time_left; /* seconds before the entry ends on its own */
	uint8_t result;  /* enum reset_result, shown once the code is entered */
};

struct kite {
	float x, y, z;
	float vx, vy;
	float speed;    /* forward speed in units per second */
	float bank;     /* visual roll angle in radians */
	float roll_t;   /* seconds left in the current barrel roll */
	float roll_dir; /* -1 or 1 */
	float roll_cooldown;
	float hit_t;    /* seconds of hit shake left */
};

struct game {
	enum game_phase phase;
	float phase_t; /* seconds spent in the current phase */
	float time;    /* seconds since boot, for animations */

	struct kite kite;
	float cam_x, cam_y, cam_z;

	struct gate gates[GAME_MAX_GATES];
	uint16_t next_gate_index;
	float last_gate_x, last_gate_y, last_gate_z;

	struct bug bugs[GAME_MAX_BUGS];
	struct particle particles[GAME_MAX_PARTICLES];
	struct popup popups[GAME_MAX_POPUPS];

	float sun;          /* remaining daylight in seconds */
	float sun_display;  /* smoothed value used for drawing */
	uint32_t score;
	uint32_t best;
	uint16_t gates_passed;
	uint8_t combo;
	uint8_t level;
	float level_blend;  /* 0..1 transition towards the current level palette */
	float level_banner; /* seconds left showing the new level */
	bool new_best;
	bool armed;         /* throttle was seen low, launching is allowed */
	bool autopilot;
	uint8_t countdown;  /* last countdown number announced */
	bool yaw_centered;  /* rudder went back to centre since the last roll */
	float shake;        /* screen shake amplitude in pixels */
	float flash;        /* full screen flash intensity 0..1 */
	uint32_t rng;

	struct high_score scores[GAME_HIGH_SCORES];
	int8_t rank;        /* table position of the last run, -1 if it did not make it */
	bool ranked;        /* the last run is in the table */
	struct letter_entry entry;
	char last_name[GAME_NAME_LEN + 1];
	bool show_scores;   /* attract mode shows the high score table */
	float page_t;       /* seconds on the current attract mode page */
	float menu_hold;    /* seconds the reset stick command was held */

	uint8_t nav;        /* direction the sticks are held in, for menus */
	float nav_repeat;   /* seconds until the held direction repeats */
	bool nav_release;   /* ignore the sticks until they are centered */
	uint8_t konami;     /* Konami code progress */
	bool retro;         /* four shades of green, unlocked with the Konami code */
	float retro_banner; /* seconds left showing the retro mode banner */
};

/* Telemetry event codes, sent in the CRSF "Game" command frame (event << 8 | arg) */
enum game_event {
	EVT_COUNTDOWN = 0x01,
	EVT_GO = 0x02,
	EVT_GATE = 0x03,
	EVT_PERFECT = 0x04,
	EVT_MISS = 0x05,
	EVT_HIT = 0x06,
	EVT_LEVEL_UP = 0x07,
	EVT_GAME_OVER = 0x08,
	EVT_NEW_BEST = 0x09,
	EVT_BARREL_ROLL = 0x0A,
	EVT_SQUASH = 0x0B,
	EVT_HIGH_SCORE = 0x0C, /* argument: rank, 1 for the top score */
	EVT_RETRO = 0x0D,      /* argument: 1 when retro mode turns on, 0 when off */
};

/* Implemented by the telemetry module, called by the game logic */
void game_emit_event(enum game_event event, uint8_t arg);
void game_emit_points(int32_t points);

/* Implemented by the storage module, called by the game logic */
void game_store_scores(const struct high_score *scores, size_t count);

void game_init(struct game *g, uint32_t seed);
void game_update(struct game *g, const struct controls *ctl, float dt);
/* Takes the high score table read back from storage */
void game_set_scores(struct game *g, const struct high_score *scores, size_t count);

/* The run is over, the kite glides down */
static inline bool game_is_over(const struct game *g)
{
	return g->phase == PHASE_GAME_OVER || g->phase == PHASE_NAME_ENTRY;
}

static inline float game_speed_ratio(const struct game *g)
{
	/* 0 at minimum airspeed, 1 at full throttle */
	float r = (g->kite.speed - GAME_SPEED_MIN) / (GAME_SPEED_MAX - GAME_SPEED_MIN);

	return r < 0.0f ? 0.0f : (r > 1.0f ? 1.0f : r);
}

#endif /* KITE_RUSH_GAME_H_ */
```

## src/gfx.c
```c
/*
 * SPDX-FileCopyrightText: Copyright The Zephyr Project Contributors
 * SPDX-License-Identifier: Apache-2.0
 */

#include <math.h>
#include <string.h>

#include <zephyr/kernel.h>
#include <zephyr/sys/util.h>

#include "font.h"
#include "gfx.h"

#define TEXT_POOL_SIZE 1024

/* Rows are grouped in bands, each band lists the primitives that reach it */
#define BAND_SHIFT   3
#define BAND_MAX     (1024 >> BAND_SHIFT)
#define BAND_ENTRIES (4 * CONFIG_KITE_RUSH_MAX_PRIMS)

enum prim_type {
	PRIM_RECT,
	PRIM_TRI,
	PRIM_ELLIPSE,
	PRIM_LINE,
	PRIM_SPRITE,
	PRIM_TEXT,
};

struct edge {
	float y0, y1; /* y0 < y1, an empty range marks a horizontal edge */
	float x0;     /* x at y0 */
	float slope;  /* dx / dy */
};

struct prim {
	uint8_t type;
	uint8_t blend;
	uint16_t alpha; /* 0..256 */
	int16_t y0, y1; /* covered rows [y0, y1) */
	uint32_t color;
	union {
		struct {
			int16_t x0, x1;
		} rect;
		struct {
			struct edge e[3];
			uint32_t c1;
			float gx, gy, gc; /* gradient position t = gx * x + gy * y + gc */
			bool gradient;
		} tri;
		struct {
			float cx, cy, rx, ry;
		} ell;
		struct {
			float x0, y0, x1, y1;
		} line;
		struct {
			float x, y, w, h;
			const struct gfx_sprite *sprite;
			uint32_t tint;
			uint8_t frame;
			uint8_t tint_amount;
		} spr;
		struct {
			int16_t x, y;
			uint16_t str;
			uint8_t scale;
			uint32_t bottom;
		} text;
	};
};

static struct prim prims[CONFIG_KITE_RUSH_MAX_PRIMS];
static int prim_count;
static uint16_t band_start[BAND_MAX + 1];
static uint16_t band_list[BAND_ENTRIES];
static bool banded;
static char text_pool[TEXT_POOL_SIZE];
static int text_used;
static int gfx_w;
static int gfx_h;

static inline int px_start(float x)
{
	/* First pixel whose centre lies at or right of x, without a libm call */
	float v = x - 0.5f;
	int i = (int)v;

	return ((float)i < v) ? i + 1 : i;
}

void gfx_begin(int width, int height)
{
	gfx_w = width;
	gfx_h = MIN(height, BAND_MAX << BAND_SHIFT);
	prim_count = 0;
	text_used = 0;
	banded = false;
}

void gfx_end(void)
{
	int bands = (gfx_h + (1 << BAND_SHIFT) - 1) >> BAND_SHIFT;
	uint16_t cursor[BAND_MAX];
	int total = 0;

	memset(cursor, 0, sizeof(cursor));
	for (int i = 0; i < prim_count; i++) {
		for (int b = prims[i].y0 >> BAND_SHIFT; b <= (prims[i].y1 - 1) >> BAND_SHIFT; b++) {
			cursor[b]++;
		}
	}

	for (int b = 0; b < bands; b++) {
		band_start[b] = (uint16_t)total;
		total += cursor[b];
		cursor[b] = band_start[b];
	}
	band_start[bands] = (uint16_t)total;

	/* Too many entries: fall back to scanning every primitive on every row */
	banded = total <= BAND_ENTRIES;
	if (!banded) {
		return;
	}

	/* Filled in primitive order, which is the drawing order */
	for (int i = 0; i < prim_count; i++) {
		for (int b = prims[i].y0 >> BAND_SHIFT; b <= (prims[i].y1 - 1) >> BAND_SHIFT; b++) {
			band_list[cursor[b]++] = (uint16_t)i;
		}
	}
}

static struct prim *prim_add(int type, float ymin, float ymax, uint32_t color, enum gfx_blend blend,
			     uint8_t alpha)
{
	struct prim *p;
	int y0 = (int)ceilf(ymin - 0.5f);
	int y1 = (int)ceilf(ymax - 0.5f);

	y0 = MAX(y0, 0);
	y1 = MIN(y1, gfx_h);
	if (y0 >= y1 || prim_count >= (int)ARRAY_SIZE(prims) || alpha == 0U) {
		return NULL;
	}

	p = &prims[prim_count++];
	p->type = (uint8_t)type;
	p->blend = (uint8_t)blend;
	p->alpha = alpha == 255U ? 256U : alpha;
	p->y0 = (int16_t)y0;
	p->y1 = (int16_t)y1;
	p->color = color;

	return p;
}

void gfx_rect(float x0, float y0, float x1, float y1, uint32_t color, enum gfx_blend blend,
	      uint8_t alpha)
{
	struct prim *p;

	if (x1 <= 0.0f || x0 >= (float)gfx_w) {
		return;
	}

	p = prim_add(PRIM_RECT, y0, y1, color, blend, alpha);
	if (p != NULL) {
		p->rect.x0 = (int16_t)MAX(px_start(x0), 0);
		p->rect.x1 = (int16_t)MIN(px_start(x1), gfx_w);
	}
}

static struct prim *tri_setup(const float v[6], uint32_t color, enum gfx_blend blend, uint8_t alpha)
{
	float ymin = MIN(v[1], MIN(v[3], v[5]));
	float ymax = MAX(v[1], MAX(v[3], v[5]));
	float xmin = MIN(v[0], MIN(v[2], v[4]));
	float xmax = MAX(v[0], MAX(v[2], v[4]));
	struct prim *p;

	if (xmax <= 0.0f || xmin >= (float)gfx_w) {
		return NULL;
	}

	p = prim_add(PRIM_TRI, ymin, ymax, color, blend, alpha);
	if (p == NULL) {
		return NULL;
	}

	for (int i = 0; i < 3; i++) {
		const float *a = &v[i * 2];
		const float *b = &v[((i + 1) % 3) * 2];
		struct edge *e = &p->tri.e[i];

		if (a[1] > b[1]) {
			const float *tmp = a;

			a = b;
			b = tmp;
		}
		e->y0 = a[1];
		e->y1 = b[1];
		e->x0 = a[0];
		e->slope = b[1] > a[1] ? (b[0] - a[0]) / (b[1] - a[1]) : 0.0f;
	}
	p->tri.gradient = false;

	return p;
}

void gfx_tri(const float v[6], uint32_t color, enum gfx_blend blend, uint8_t alpha)
{
	(void)tri_setup(v, color, blend, alpha);
}

void gfx_tri_gradient(const float v[6], uint32_t c0, uint32_t c1, const float g[4])
{
	struct prim *p = tri_setup(v, c0, GFX_SOLID, 255);
	float dx = g[2] - g[0];
	float dy = g[3] - g[1];
	float len2 = dx * dx + dy * dy;

	if (p == NULL || len2 < 1e-6f) {
		return;
	}

	p->tri.gradient = true;
	p->tri.c1 = c1;
	p->tri.gx = dx / len2;
	p->tri.gy = dy / len2;
	p->tri.gc = -(g[0] * dx + g[1] * dy) / len2;
}

void gfx_ellipse(float cx, float cy, float rx, float ry, uint32_t color, enum gfx_blend blend,
		 uint8_t alpha)
{
	struct prim *p;

	if (rx < 0.3f || ry < 0.3f || cx + rx <= 0.0f || cx - rx >= (float)gfx_w) {
		return;
	}

	p = prim_add(PRIM_ELLIPSE, cy - ry, cy + ry, color, blend, alpha);
	if (p != NULL) {
		p->ell.cx = cx;
		p->ell.cy = cy;
		p->ell.rx = rx;
		p->ell.ry = ry;
	}
}

void gfx_line(float x0, float y0, float x1, float y1, uint32_t color, enum gfx_blend blend,
	      uint8_t alpha)
{
	struct prim *p;

	if (y0 > y1) {
		float t = y0;

		y0 = y1;
		y1 = t;
		t = x0;
		x0 = x1;
		x1 = t;
	}

	p = prim_add(PRIM_LINE, floorf(y0) + 0.5f, floorf(y1) + 1.5f, color, blend, alpha);
	if (p != NULL) {
		p->line.x0 = x0;
		p->line.y0 = y0;
		p->line.x1 = x1;
		p->line.y1 = y1;
	}
}

void gfx_sprite(float x, float y, float w, float h, const struct gfx_sprite *sprite,
		uint8_t frame, uint32_t tint, uint8_t tint_amount)
{
	struct prim *p;

	if (w < 1.0f || h < 1.0f || x + w <= 0.0f || x >= (float)gfx_w) {
		return;
	}

	p = prim_add(PRIM_SPRITE, y, y + h, 0, GFX_SOLID, 255);
	if (p != NULL) {
		p->spr.x = x;
		p->spr.y = y;
		p->spr.w = w;
		p->spr.h = h;
		p->spr.sprite = sprite;
		p->spr.frame = frame % sprite->frames;
		p->spr.tint = tint;
		p->spr.tint_amount = tint_amount;
	}
}

int gfx_text_width(const char *str, int scale)
{
	int n = (int)strlen(str);

	return n > 0 ? (n * 6 - 1) * scale : 0;
}

void gfx_text(float x, float y, int scale, const char *str, uint32_t top, uint32_t bottom,
	      uint8_t alpha)
{
	size_t len = strlen(str) + 1U;
	struct prim *p;

	if ((size_t)text_used + len > sizeof(text_pool) || scale < 1) {
		return;
	}

	x = roundf(x);
	y = roundf(y);
	p = prim_add(PRIM_TEXT, y, y + (float)(7 * scale), top,
		     alpha == 255U ? GFX_SOLID : GFX_ALPHA, alpha);
	if (p == NULL) {
		return;
	}

	memcpy(&text_pool[text_used], str, len);
	p->text.x = (int16_t)x;
	p->text.y = (int16_t)y;
	p->text.str = (uint16_t)text_used;
	p->text.scale = (uint8_t)scale;
	p->text.bottom = bottom;
	text_used += (int)len;
}

void gfx_text_centered(float cx, float y, int scale, const char *str, uint32_t top,
		       uint32_t bottom, uint8_t alpha, uint32_t shadow)
{
	float x = cx - (float)gfx_text_width(str, scale) / 2.0f;
	int off = MAX(1, scale / 2);

	if (shadow != 0U) {
		gfx_text(x + (float)off, y + (float)off, scale, str, shadow, shadow,
			 (uint8_t)MIN(255U, alpha * 3U / 4U));
	}
	gfx_text(x, y, scale, str, top, bottom, alpha);
}

static void fill(uint32_t *row, int x0, int x1, uint32_t color, uint8_t blend, uint32_t alpha)
{
	x0 = MAX(x0, 0);
	x1 = MIN(x1, gfx_w);

	switch (blend) {
	case GFX_SOLID:
		gfx_fill32(&row[x0], color, x1 - x0);
		break;
	case GFX_ALPHA:
		for (int x = x0; x < x1; x++) {
			row[x] = gfx_mix(row[x], color, alpha);
		}
		break;
	default:
		for (int x = x0; x < x1; x++) {
			row[x] = gfx_add(row[x], color, alpha);
		}
		break;
	}
}

static void draw_tri(uint32_t *row, const struct prim *p, float yc)
{
	float xl = 1e9f;
	float xr = -1e9f;
	int32_t tf, dtf;
	int x0, x1;

	for (int i = 0; i < 3; i++) {
		const struct edge *e = &p->tri.e[i];
		float x;

		if (yc < e->y0 || yc >= e->y1) {
			continue;
		}
		x = e->x0 + (yc - e->y0) * e->slope;
		xl = MIN(xl, x);
		xr = MAX(xr, x);
	}
	if (xl >= xr) {
		return;
	}

	x0 = MAX(px_start(xl), 0);
	x1 = MIN(px_start(xr), gfx_w);

	if (!p->tri.gradient) {
		fill(row, x0, x1, p->color, p->blend, p->alpha);
		return;
	}

	/* Gradient position stepped in 16.16 fixed point */
	tf = (int32_t)((p->tri.gx * ((float)x0 + 0.5f) + p->tri.gy * yc + p->tri.gc) * 65536.0f);
	dtf = (int32_t)(p->tri.gx * 65536.0f);

	for (int x = x0; x < x1; x++) {
		int32_t k = tf >> 8;

		k = k < 0 ? 0 : (k > 256 ? 256 : k);
		row[x] = gfx_mix(p->color, p->tri.c1, (uint32_t)k);
		tf += dtf;
	}
}

static void draw_ellipse(uint32_t *row, const struct prim *p, float yc)
{
	float dy = (yc - p->ell.cy) / p->ell.ry;
	float hw;

	if (dy * dy >= 1.0f) {
		return;
	}
	hw = p->ell.rx * sqrtf(1.0f - dy * dy);
	fill(row, px_start(p->ell.cx - hw), px_start(p->ell.cx + hw), p->color, p->blend, p->alpha);
}

static void draw_line(uint32_t *row, const struct prim *p, int y)
{
	float ya = MAX((float)y, p->line.y0);
	float yb = MIN((float)y + 1.0f, p->line.y1);
	float xa, xb, dy = p->line.y1 - p->line.y0;

	if (dy < 1e-3f) {
		xa = p->line.x0;
		xb = p->line.x1;
	} else {
		xa = p->line.x0 + (ya - p->line.y0) * (p->line.x1 - p->line.x0) / dy;
		xb = p->line.x0 + (yb - p->line.y0) * (p->line.x1 - p->line.x0) / dy;
	}
	if (xa > xb) {
		float t = xa;

		xa = xb;
		xb = t;
	}
	fill(row, (int)floorf(xa), (int)floorf(xb) + 1, p->color, p->blend, p->alpha);
}

static void draw_sprite(uint32_t *row, const struct prim *p, float yc)
{
	const struct gfx_sprite *s = p->spr.sprite;
	int sy = (int)((yc - p->spr.y) * (float)s->h / p->spr.h);
	int x0 = MAX(px_start(p->spr.x), 0);
	int x1 = MIN(px_start(p->spr.x + p->spr.w), gfx_w);
	const uint8_t *src;
	int32_t u, du;

	if (sy < 0 || sy >= s->h || x0 >= x1) {
		return;
	}

	src = &s->pixels[((size_t)p->spr.frame * s->h + (size_t)sy) * s->w];
	du = (int32_t)((float)s->w / p->spr.w * 65536.0f);
	u = (int32_t)(((float)x0 + 0.5f - p->spr.x) * (float)s->w / p->spr.w * 65536.0f);

	for (int x = x0; x < x1; x++, u += du) {
		int sx = MIN(MAX(u >> 16, 0), s->w - 1);
		uint8_t idx = src[sx];

		if (idx != 0U) {
			row[x] = gfx_mix(s->palette[idx], p->spr.tint, p->spr.tint_amount);
		}
	}
}

static void draw_text(uint32_t *row, const struct prim *p, int y)
{
	int scale = p->text.scale;
	int gy = (y - p->text.y) / scale;
	const char *str = &text_pool[p->text.str];
	uint32_t color;
	int x;

	if (gy < 0 || gy >= FONT_HEIGHT) {
		return;
	}

	color = gfx_mix(p->color, p->text.bottom, (uint32_t)(gy * 256 / (FONT_HEIGHT - 1)));
	x = p->text.x;

	for (; *str != '\0'; str++, x += (FONT_WIDTH + 1) * scale) {
		uint8_t bits = font_glyph(*str)[gy];

		if (x >= gfx_w) {
			break;
		}
		for (int col = 0; col < FONT_WIDTH; col++) {
			if ((bits & (0x10U >> col)) != 0U) {
				int px = x + col * scale;

				fill(row, px, px + scale, color, p->blend, p->alpha);
			}
		}
	}
}

void gfx_draw_row(uint32_t *row, int y)
{
	float yc = (float)y + 0.5f;
	int first = 0;
	int count = prim_count;

	if (banded) {
		first = band_start[y >> BAND_SHIFT];
		count = band_start[(y >> BAND_SHIFT) + 1] - first;
	}

	for (int n = 0; n < count; n++) {
		const struct prim *p = &prims[banded ? band_list[first + n] : n];

		if (y < p->y0 || y >= p->y1) {
			continue;
		}

		switch (p->type) {
		case PRIM_RECT:
			fill(row, p->rect.x0, p->rect.x1, p->color, p->blend, p->alpha);
			break;
		case PRIM_TRI:
			draw_tri(row, p, yc);
			break;
		case PRIM_ELLIPSE:
			draw_ellipse(row, p, yc);
			break;
		case PRIM_LINE:
			draw_line(row, p, y);
			break;
		case PRIM_SPRITE:
			draw_sprite(row, p, yc);
			break;
		case PRIM_TEXT:
			draw_text(row, p, y);
			break;
		default:
			break;
		}
	}
}
```

## src/gfx.h
```c
/*
 * SPDX-FileCopyrightText: Copyright The Zephyr Project Contributors
 * SPDX-License-Identifier: Apache-2.0
 */

#ifndef KITE_RUSH_GFX_H_
#define KITE_RUSH_GFX_H_

#include <stdint.h>

/*
 * Scanline rasterizer: primitives are queued in a display list, then drawn
 * one logical row at a time, so no frame buffer is needed. Colors are
 * 0x00RRGGBB.
 */

enum gfx_blend {
	GFX_SOLID,
	GFX_ALPHA,
	GFX_ADD,
};

struct gfx_sprite {
	uint8_t w;
	uint8_t h;
	uint8_t frames;
	const uint8_t *pixels;   /* w * h * frames palette indices, 0 is transparent */
	const uint32_t *palette;
};

void gfx_begin(int width, int height);
/* Call once all primitives of the frame are queued, before drawing rows */
void gfx_end(void);
void gfx_draw_row(uint32_t *row, int y);

void gfx_rect(float x0, float y0, float x1, float y1, uint32_t color, enum gfx_blend blend,
	      uint8_t alpha);
void gfx_tri(const float v[6], uint32_t color, enum gfx_blend blend, uint8_t alpha);
/* Triangle with a linear gradient from c0 at g[0..1] to c1 at g[2..3] */
void gfx_tri_gradient(const float v[6], uint32_t c0, uint32_t c1, const float g[4]);
void gfx_ellipse(float cx, float cy, float rx, float ry, uint32_t color, enum gfx_blend blend,
		 uint8_t alpha);
void gfx_line(float x0, float y0, float x1, float y1, uint32_t color, enum gfx_blend blend,
	      uint8_t alpha);
void gfx_sprite(float x, float y, float w, float h, const struct gfx_sprite *sprite,
		uint8_t frame, uint32_t tint, uint8_t tint_amount);
/* Text in the built-in 5x7 font, colors fade from top to bottom of the glyphs */
void gfx_text(float x, float y, int scale, const char *str, uint32_t top, uint32_t bottom,
	      uint8_t alpha);
void gfx_text_centered(float cx, float y, int scale, const char *str, uint32_t top,
		       uint32_t bottom, uint8_t alpha, uint32_t shadow);
int gfx_text_width(const char *str, int scale);

/* Unrolled, a plain store loop costs about four instructions per pixel */
static inline void gfx_fill32(uint32_t *p, uint32_t c, int n)
{
	for (; n >= 4; n -= 4, p += 4) {
		p[0] = c;
		p[1] = c;
		p[2] = c;
		p[3] = c;
	}
	for (; n > 0; n--) {
		*p++ = c;
	}
}

static inline uint32_t gfx_rgb(uint8_t r, uint8_t g, uint8_t b)
{
	return ((uint32_t)r << 16) | ((uint32_t)g << 8) | b;
}

/* Blend a towards b, t in 0..256 */
static inline uint32_t gfx_mix(uint32_t a, uint32_t b, uint32_t t)
{
	uint32_t rb = (((a & 0xff00ffU) * (256U - t)) + ((b & 0xff00ffU) * t)) >> 8;
	uint32_t g = (((a & 0x00ff00U) * (256U - t)) + ((b & 0x00ff00U) * t)) >> 8;

	return (rb & 0xff00ffU) | (g & 0x00ff00U);
}

static inline uint32_t gfx_mixf(uint32_t a, uint32_t b, float t)
{
	t = t < 0.0f ? 0.0f : (t > 1.0f ? 1.0f : t);

	return gfx_mix(a, b, (uint32_t)(t * 256.0f));
}

/* Saturating add of b scaled by alpha (0..256) */
static inline uint32_t gfx_add(uint32_t a, uint32_t b, uint32_t alpha)
{
	uint32_t r = ((a >> 16) & 0xffU) + ((((b >> 16) & 0xffU) * alpha) >> 8);
	uint32_t g = ((a >> 8) & 0xffU) + ((((b >> 8) & 0xffU) * alpha) >> 8);
	uint32_t bl = (a & 0xffU) + (((b & 0xffU) * alpha) >> 8);

	r = r > 255U ? 255U : r;
	g = g > 255U ? 255U : g;
	bl = bl > 255U ? 255U : bl;

	return (r << 16) | (g << 8) | bl;
}

#endif /* KITE_RUSH_GFX_H_ */
```

## src/kite.c
```c
/*
 * SPDX-FileCopyrightText: Copyright The Zephyr Project Contributors
 * SPDX-License-Identifier: Apache-2.0
 */

#include <math.h>

#include <zephyr/sys/util.h>

#include "gfx.h"
#include "kite.h"

/* Logo coordinates (doc/_static/images/logo.svg), body centre E */
#define E_X 220.982f
#define E_Y 44.482f

/* Tail runs from the body corner to the tip */
#define TAIL_ROOT_X 137.154f
#define TAIL_SPAN   128.4f

struct facet {
	float v[6];
	float g[4]; /* gradient start and end */
	uint32_t c0, c1;
};

static const struct facet body[] = {
	{{137.154f, 121.601f, 220.982f, 44.482f, 258.666f, 94.416f},
	 {173.227f, 83.041f, 269.621f, 83.041f},
	 0x7929d2U,
	 0x0070c5U},
	{{137.154f, 121.601f, 172.959f, 8.13f, 220.982f, 44.482f},
	 {179.787f, -1.879f, 178.980f, 93.408f},
	 0x00aeffU,
	 0x9454dbU},
	{{172.959f, 8.13f, 258.666f, 8.13f, 220.982f, 44.482f},
	 {232.845f, 37.632f, 212.266f, 1.987f},
	 0x66a9dcU,
	 0xb1e4faU},
	{{258.666f, 94.416f, 258.666f, 8.13f, 220.982f, 44.482f},
	 {237.423f, 9.703f, 249.116f, 90.577f},
	 0x00aeffU,
	 0x9454dbU},
};

static const struct {
	float v[6];
	uint32_t color;
} tail[] = {
	{{137.154f, 121.601f, 105.31f, 135.046f, 132.385f, 148.72f}, 0x7929d2U},
	{{84.508f, 115.518f, 105.31f, 135.046f, 68.401f, 139.419f}, 0xaf7fe4U},
	{{68.401f, 139.419f, 34.434f, 126.703f, 42.309f, 153.408f}, 0x9454dbU},
	{{38.535f, 97.167f, 34.434f, 126.703f, 8.759f, 101.076f}, 0xaf7fe4U},
};

struct xform {
	float cx, cy, s, ca, sa;
};

static void apply(const struct xform *xf, float lx, float ly, float *out)
{
	float dx = (lx - E_X) * xf->s;
	float dy = (ly - E_Y) * xf->s;

	out[0] = xf->cx + dx * xf->ca - dy * xf->sa;
	out[1] = xf->cy + dx * xf->sa + dy * xf->ca;
}

static void tail_point(const struct kite_pose *pose, float lx, float ly, float *ox, float *oy)
{
	float u = (TAIL_ROOT_X - lx) / TAIL_SPAN;

	u = u < 0.0f ? 0.0f : (u > 1.0f ? 1.0f : u);
	*ox = lx - pose->swing * u * 45.0f;
	*oy = ly + pose->flutter * u * sinf(pose->time * 9.0f - u * 4.5f);
}

void kite_draw(const struct kite_pose *pose)
{
	struct xform xf = {
		.cx = pose->x,
		.cy = pose->y,
		.s = pose->scale,
		.ca = cosf(pose->angle),
		.sa = sinf(pose->angle),
	};
	struct xform outline = xf;
	float v[6], g[4];

	/* Dark silhouette behind the body keeps it readable on any sky */
	outline.s *= 1.14f;
	for (size_t i = 0; i < ARRAY_SIZE(body); i++) {
		for (int k = 0; k < 3; k++) {
			apply(&outline, body[i].v[k * 2], body[i].v[k * 2 + 1], &v[k * 2]);
		}
		gfx_tri(v, 0x0b0322U, GFX_SOLID, 255);
	}

	for (size_t i = 0; i < ARRAY_SIZE(tail); i++) {
		for (int k = 0; k < 3; k++) {
			float lx, ly;

			tail_point(pose, tail[i].v[k * 2], tail[i].v[k * 2 + 1], &lx, &ly);
			apply(&xf, lx, ly, &v[k * 2]);
		}
		gfx_tri(v, gfx_mix(tail[i].color, pose->tint, pose->tint_amount), GFX_SOLID, 255);
	}

	for (size_t i = 0; i < ARRAY_SIZE(body); i++) {
		for (int k = 0; k < 3; k++) {
			apply(&xf, body[i].v[k * 2], body[i].v[k * 2 + 1], &v[k * 2]);
		}
		apply(&xf, body[i].g[0], body[i].g[1], &g[0]);
		apply(&xf, body[i].g[2], body[i].g[3], &g[2]);
		gfx_tri_gradient(v, gfx_mix(body[i].c0, pose->tint, pose->tint_amount),
				 gfx_mix(body[i].c1, pose->tint, pose->tint_amount), g);
	}
}
```

## src/kite.h
```c
/*
 * SPDX-FileCopyrightText: Copyright The Zephyr Project Contributors
 * SPDX-License-Identifier: Apache-2.0
 */

#ifndef KITE_RUSH_KITE_H_
#define KITE_RUSH_KITE_H_

#include <stdint.h>

/* Width of the kite body in logo units */
#define KITE_BODY_WIDTH 121.5f

struct kite_pose {
	float x, y;    /* screen position of the body centre */
	float scale;   /* pixels per logo unit */
	float angle;   /* rotation in radians, positive is clockwise */
	float time;    /* drives the tail flutter */
	float swing;   /* -1..1, tail trails opposite to lateral motion */
	float flutter; /* tail wave amplitude in logo units */
	uint32_t tint;
	uint8_t tint_amount;
};

/* Queues the Zephyr kite, built from the logo geometry */
void kite_draw(const struct kite_pose *pose);

#endif /* KITE_RUSH_KITE_H_ */
```

## src/render.h
```c
/*
 * SPDX-FileCopyrightText: Copyright The Zephyr Project Contributors
 * SPDX-License-Identifier: Apache-2.0
 */

#ifndef KITE_RUSH_RENDER_H_
#define KITE_RUSH_RENDER_H_

#include <zephyr/device.h>

#include "game.h"

/* Cycles spent per stage since the last call, see CONFIG_KITE_RUSH_PROFILE */
struct render_stats {
	uint32_t scene;
	uint32_t background;
	uint32_t shapes;
	uint32_t output;
	uint32_t wait;
	uint32_t rows_sent;
};

int render_init(const struct device *display);
void render_frame(const struct game *g, const struct controls *ctl);
void render_take_stats(struct render_stats *stats);

#endif /* KITE_RUSH_RENDER_H_ */
```
