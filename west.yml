## zephyr-module/apps/magic_wand/Kconfig
```kconfig
# Copyright (c) 2026 Benjamin Cabé <benjamin@zephyrproject.org>
# SPDX-License-Identifier: Apache-2.0

config MAGIC_WAND_INFERENCE_STRIDE
	int "Samples between inferences"
	default 1
	range 1 10
	help
	  Run inference at most every this many accelerometer samples, once
	  the 128-sample window is full. 1 matches upstream: an inference per
	  sample, at 25 Hz. Sampling runs in its own thread, so an inference
	  slower than a sample period (40 ms) only makes inference run less
	  often; raise this to spend less CPU on it.

source "Kconfig.zephyr"
```

## zephyr-module/dts/bindings/i2c/virtio,i2c.yaml
```yaml
# SPDX-FileCopyrightText: Copyright The Zephyr Project Contributors
# SPDX-License-Identifier: Apache-2.0

description: |
  VIRTIO I2C adapter device (ID:34)

  The node is a child of the virtio bus node the device sits on, and is itself
  an I2C bus, so the chips on it hang off it as usual:

    virtio_mmio4: virtio_mmio@a000800 {
            compatible = "virtio,mmio";
            reg = <0xa000800 0x200>;
            interrupts = <0 20 4>;
            status = "okay";

            virtio_i2c0: virtio-i2c {
                    compatible = "virtio,i2c";
                    #address-cells = <1>;
                    #size-cells = <0>;
                    status = "okay";

                    eeprom0: eeprom@50 {
                            compatible = "atmel,at24";
                            reg = <0x50>;
                            size = <256>;
                            pagesize = <8>;
                            address-width = <8>;
                            timeout = <5>;
                    };
            };
    };

  The adapter has no device configuration fields and offers no feature bits, so
  the node carries no properties of its own beyond the I2C bus ones.

compatible: "virtio,i2c"

include: [i2c-controller.yaml, base.yaml]
```

## zephyr-module/dts/bindings/pm/zephyr,pm-demo-device.yaml
```yaml
# SPDX-FileCopyrightText: Copyright The Zephyr Project Contributors
# SPDX-License-Identifier: Apache-2.0

description: |
  A device that exists only to have power management.

  System-managed device power management (CONFIG_PM_DEVICE_SYSTEM_MANAGED) has
  the PM core suspend every device before the CPU enters a power state, and
  resume them on the way out. Nothing on the QEMU boards this repo runs can
  demonstrate that: not one driver in a browser_bridge build implements a PM
  action callback, so pm_suspend_devices() walks the whole device list, gets
  -ENOSYS from all of it, and honestly reports that it suspended nothing.

  This device does implement the callback, and deliberately burns a configurable
  number of microseconds doing it, so the suspend and resume walks have
  measurable width in a trace instead of being instantaneous. That width is the
  engineering point of the feature: entering a deep state is not free, and the
  device walk is where a good part of the cost lives.

  Instantiate a few. pm_suspend_devices() walks the static device list backwards
  and resumes in the reverse of that, so the visit order is devicetree order
  reversed — fixed and reproducible, which is what a trace wants:

    pm_demo_sensor: pm-demo-sensor {
            compatible = "zephyr,pm-demo-device";
            suspend-time-us = <150>;
            resume-time-us = <300>;
    };

compatible: "zephyr,pm-demo-device"

include: base.yaml

properties:
  suspend-time-us:
    type: int
    default: 0
    description: |
      Microseconds to spend in PM_DEVICE_ACTION_SUSPEND, busy-waiting. The
      default of 0 makes the action free, which is valid but invisible.

  resume-time-us:
    type: int
    default: 0
    description: |
      Microseconds to spend in PM_DEVICE_ACTION_RESUME, busy-waiting. Resume is
      usually the more expensive direction on real hardware, so it is worth
      setting this higher than suspend-time-us.
```

## zephyr-module/dts/bindings/spi/virtio,spi.yaml
```yaml
# Copyright (c) 2026 Benjamin Cabé <benjamin@zephyrproject.org>
# SPDX-License-Identifier: Apache-2.0

description: |
  VIRTIO SPI controller device (ID:45).

  This node must be a child of a VIRTIO transport node, for example:

    &virtio_mmio0 {
            status = "okay";

            virtio_spi: virtio-spi {
                    compatible = "virtio,spi";
                    status = "okay";
                    #address-cells = <1>;
                    #size-cells = <0>;
            };
    };

  The chip select of a device on the bus is given by the "reg" property of its
  node, and is passed to the VIRTIO device, which drives the corresponding chip
  select line. The number of usable chip selects is reported by the device.

compatible: "virtio,spi"

include: [spi-controller.yaml]
```
